## 3rd-party/xiaozhi/Kconfig
```kconfig
menuconfig RTSMART_XIAOZHI_MCP_LIGHT
    bool "Enable XiaoZhi GPIO light MCP tool"
    default y if BOARD_K230_CANMV_01STUDIO
    default n
    help
        Advertise self.light.get_state and self.light.set_state MCP tools for
        a board GPIO light.
        Disable this option when the board has no light connected. The tool
        is not registered when this option is disabled or the GPIO cannot be
        initialized.

if RTSMART_XIAOZHI_MCP_LIGHT

    config RTSMART_XIAOZHI_MCP_LIGHT_GPIO
        int "XiaoZhi light GPIO pin"
        default 52 if BOARD_K230_CANMV_01STUDIO
        default -1
        range -1 71
        help
            GPIO number connected to the light. Set this to -1 when the
            board has no controllable light.

    config RTSMART_XIAOZHI_MCP_LIGHT_ON_VALUE
        int "GPIO output value when the light is on"
        default 1
        range 0 1
        help
            GPIO output value that turns the light on. The other value is
            used for off. The 01Studio board uses GPIO52 and value 1.

endif
```

## Kconfig
```kconfig
menuconfig RTT_ENABLE_BUILD_EXAMPLES
    bool "RT-Smart UserSpace Examples Configuration"
    default n
    depends on !SDK_ENABLE_CANMV

    if RTT_ENABLE_BUILD_EXAMPLES

        menuconfig RTT_ENABLE_3RD_PARTY_EXAMPLES
            bool "Enable 3rd-party examples"
            default n

            if RTT_ENABLE_3RD_PARTY_EXAMPLES
                source "$(SDK_RTSMART_SRC_DIR)/examples/3rd-party/Kconfig"
            endif

        menuconfig RTT_ENABLE_PERIPHERAL_EXAMPLES
            bool "Enable build peripheral examples"
            default n

            if RTT_ENABLE_PERIPHERAL_EXAMPLES
                source "$(SDK_RTSMART_SRC_DIR)/examples/peripheral/Kconfig"
            endif

        menuconfig RTT_ENABLE_MPP_EXAMPLES
            bool "Enable MPP examples"
            default n

            if RTT_ENABLE_MPP_EXAMPLES
                source "$(SDK_RTSMART_SRC_DIR)/examples/mpp/Kconfig"
            endif

        menuconfig RTT_ENABLE_AI_EXAMPLES
            bool "Enable build ai examples"
            default n

            if RTT_ENABLE_AI_EXAMPLES
                source "$(SDK_RTSMART_SRC_DIR)/examples/ai/Kconfig"
            endif


        menuconfig RTT_ENABLE_BUILD_INTEGRATED_EXAMPLES
            bool "Enable build integrated examples"
            default n

            if RTT_ENABLE_BUILD_INTEGRATED_EXAMPLES
                source "$(SDK_RTSMART_SRC_DIR)/examples/integrated_poc/Kconfig"
            endif

    endif
```

## ai/Kconfig
```kconfig
if RTT_ENABLE_AI_EXAMPLES

    config RTSMART_AI_EXAMPLES_ENABLE_AI_DEMO
        bool "Enable Build AI Demo Programs"
        default n

        if RTSMART_AI_EXAMPLES_ENABLE_AI_DEMO
                source "$(SDK_RTSMART_SRC_DIR)/examples/ai/ai_demo/Kconfig"
            endif


    config RTSMART_AI_EXAMPLES_ENABLE_CLOUDPLAT_DEPLOY_CODE
        bool "Enable Build CloudPlat Deploy Programs"
        default n

    config RTSMART_AI_EXAMPLES_ENABLE_FACE_DETECTION
        bool "Enable Build Face Detection Programs"
        default n
    
    config RTSMART_AI_EXAMPLES_ENABLE_FACE_RECOGNITION
        bool "Enable Build Face Recognition Programs"
        default n

    config RTSMART_AI_EXAMPLES_ENABLE_MULTI_OBJECT_TRACKING
        bool "Enable Build MOT(Multi-Object Tracking) Programs"
        default n

        if RTSMART_AI_EXAMPLES_ENABLE_MULTI_OBJECT_TRACKING
            config RTSMART_BOTSORT_TRACK_ALGORITHM
                bool "Botsort tracking algorithm"
                default n

            config RTSMART_BYTETRACK_TRACK_ALGORITHM
                bool "Bytetrack tracking algorithm"
                default n

            config RTSMART_DEEPSORT_TRACK_ALGORITHM
                bool "Deepsort tracking algorithm"
                default n

            config RTSMART_OCSORT_TRACK_ALGORITHM
                bool "Ocsort tracking algorithm"
                default n
        endif

    config RTSMART_AI_EXAMPLES_ENABLE_TRIPLE_CAMERA_AI
        bool "Enable Build Triple Camera AI Programs"
        default n

    config RTSMART_AI_EXAMPLES_ENABLE_TRIPLE_CAMERA_AI_RTSP
        bool "Enable Build Triple Camera AI with RTSP Programs"
        default n

    config RTSMART_AI_EXAMPLES_ENABLE_USAGE_AI2D
        bool "Enable Build AI2D Sample Programs"
        default n

    config RTSMART_AI_EXAMPLES_ENABLE_USAGE_KPU
        bool "Enable Build KPU Sample Programs"
        default n

    config RTSMART_AI_EXAMPLES_ENABLE_UVC_FACE_DETECTION
        bool "Enable Build UVC+AI Programs"
        default n
    
    config RTSMART_AI_EXAMPLES_ENABLE_YOLO
        bool "Enable Build YOLO Programs"
        default n

    
endif
```

## mpp/Kconfig
```kconfig
if RTT_ENABLE_MPP_EXAMPLES

  config RTT_ENABLE_MPP_EXAMPLES_AUDIO
      bool "Enable Build sample_audio"
      default n
      help
        Audio functionality demo: AI/AO, AENC/ADEC G.711/Opus, and I2S/PDM testing.

  config RTSMART_MPP_ENABLE_SAMPLE_CIPHER
      bool "Enable Build sample_cipher"
      default n
      help
        Security samples: Includes AES, Hash, Hardware Hash, and PUFS demos.

  config RTSMART_MPP_ENABLE_SAMPLE_CSC
      bool "Enable Build sample_csc"
      default n
      help
        Color Space Conversion and OSD hardware acceleration demo.

  config RTSMART_MPP_ENABLE_SAMPLE_DEMUXER
      bool "Enable Build sample_demuxer"
      default n
      help
        MP4 Demuxer: Extract raw bitstreams from MP4 containers.

  config RTSMART_MPP_ENABLE_SAMPLE_FFT_DISPLAY
      bool "Enable Build sample_fft_display"
      default n

  config RTSMART_MPP_ENABLE_SAMPLE_GSDMA
      bool "Enable Build sample_gsdma"
      default n
      help
        GDMA/SDMA data transfer and rotation accuracy testing.

  config RTSMART_MPP_ENABLE_SAMPLE_LOG
      bool "Enable Build sample_log"
      default n
      help
        Mpp Log interface testing and log level demonstration.

  config RTSMART_MPP_ENABLE_SAMPLE_MMZ
      bool "Enable Build sample_mmz"
      default n
      help
        Mpp Multimedia Memory Zone MMZ API usage demo.

  config RTSMART_MPP_ENABLE_SAMPLE_MUXER
      bool "Enable Build sample_muxer"
      default n
      help
        MP4 Muxer: Record video and audio into standard MP4 files.

  config RTSMART_MPP_ENABLE_SAMPLE_NONAI_2D
      bool "Enable Build sample_nonai_2d"
      default n
      help
        Hardware 2D acceleration for OSD graphic overlays on YUV frames.

  config RTSMART_MPP_ENABLE_SAMPLE_OGG
      bool "Enable Build sample_ogg"
      default n
      help
        Ogg/Opus loopback demo: Capture -> Encode -> Mux -> Demux -> Decode -> Play.

  config RTSMART_MPP_ENABLE_SAMPLE_PLAYER
      bool "Enable Build sample_player"
      default n
      help
        Lightweight media player for MP4 files via LCD or HDMI.

  config RTSMART_MPP_ENABLE_SAMPLE_PM
      bool "Enable Build sample_pm"
      default n
      help
        Power Management IC PMIC demonstration for EVB boards.

  config RTSMART_MPP_ENABLE_SAMPLE_RTSPCLIENT
      bool "Enable Build sample_rtspclient"
      default n
      help
        RTSP Client: Pull stream from server and decode for playback.

  config RTSMART_MPP_ENABLE_SAMPLE_RTSPPUSHER
      bool "Enable Build sample_rtsppusher"
      default n
      depends on MPP_ENABLE_MIDDLEWARE_LIB_RTSP_PUSHER
      help
        RTSP Pusher: Push local camera feed to a remote RTSP server.

  config RTSMART_MPP_ENABLE_SAMPLE_RTSPSERVER
      bool "Enable Build sample_rtspserver"
      default n
      help
        RTSP Server: Provide local camera/audio as an RTSP stream.

  config RTSMART_MPP_ENABLE_SAMPLE_UVC_DEV_PICTURE
      bool "Enable Build sample_uvc_dev_picture"
      default n
      help
        UVC Device: Simulate a USB camera using a static firmware picture.

  config RTSMART_MPP_ENABLE_SAMPLE_UVC_DEV_VICAP
      bool "Enable Build sample_uvc_dev_vicap"
      default n
      help
        UVC Device: Simulate a USB camera using live local sensor data.

  config RTSMART_MPP_ENABLE_SAMPLE_UVC_HOST
      bool "Enable Build sample_uvc_host"
      default n
      help
        UVC Host: Access and display data from an external USB camera.

  config RTSMART_MPP_ENABLE_SAMPLE_VB
      bool "Enable Build sample_vb"
      default n
      help
        Video Buffer VB pool management and block allocation demo.

  config RTSMART_MPP_ENABLE_SAMPLE_VDEC
      bool "Enable Build sample_vdec"
      default n
      help
        Video Decoder: Hardware H.264/H.265 decoding to display.

  config RTSMART_MPP_ENABLE_SAMPLE_VENC
      bool "Enable Build sample_venc"
      default n
      help
        Video Encoder: Hardware H.264/H.265/JPEG encoding to file.

  config RTSMART_MPP_ENABLE_SAMPLE_VICAP
      bool "Enabel Build sample_vicap_sensor"
      default n
      help
        Vicap Bind to Display and Dump to File

  config RTSMART_MPP_ENABLE_SAMPLE_VO_MIX_ORDER
      bool "Enable Build sample_vo_mix_order"
      default n
      help
        Video Output: Demonstrate mixing order of different display layers.

  config RTSMART_MPP_ENABLE_SAMPLE_VO_OSD
      bool "Enable Build sample_vo_osd"
      default n
      help
        Video Output: Displaying images on OSD layers with rotation.

  config RTSMART_MPP_ENABLE_SAMPLE_VO_VIDEO
      bool "Enable Build sample_vo_video"
      default n
      help
        Video Output: Displaying live video on Video layers with rotation.

  config RTSMART_MPP_ENABLE_SAMPLE_VO_WBC_DUMP
      bool "Enable Build sample_vo_wbc_dump"
      default n
      help
        Video Output: Using Write Back Channel WBC to dump screen content to file.

endif
```
