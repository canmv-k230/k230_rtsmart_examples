## 3rd-party/Kconfig
```kconfig
if RTSMART_ENABLE_3RD_PARTY_EXAMPLES

    config RTSMART_3RD_PARTY_ENABLE_OPENCV_SAMPLES
        bool "Enable Build OpenCV Sample Programs"
        default n

    config RTSMART_3RD_PARTY_ENABLE_OPENBLAS_SAMPLES
        bool "Enable Build OpenBlas Sample Programs"
        default n

    config RTSMART_3RD_PARTY_ENABLE_FREETYPE_SAMPLES
        bool "Enable Build FreeType Sample Programs"
        default n
        depends on RTSMART_3RD_PARTY_ENABLE_FREETYPE

    config RTSMART_3RD_PARTY_ENABLE_LVGL_SAMPLES
        bool "Enable Build Lvgl Sample Programs"
        default n
        depends on RTSMART_3RD_PARTY_ENABLE_LVGL

    config RTSMART_3RD_PARTY_ENABLE_MBEDTLS_TESTS
        bool "Enable Build MbedTLS Test Programs"
        default n
        depends on RTSMART_3RD_PARTY_ENABLE_MBEDTLS

    config RTSMART_LIBS_MQTTCLIENT_ENABLE_TESTS
        bool "Enable Build RtSmart MQTT Client Tests"
        default n
        depends on RTSMART_3RD_PARTY_ENABLE_MQTTCLIENT

    config RTSMART_LIBS_MINIHTTP_ENABLE_SAMPLES
        bool "Enable Build RtSmart minihttp Client Samples"
        default n
        depends on RTSMART_3RD_PARTY_ENABLE_MINIHTTP

    config RTSMART_3RD_PARTY_ENABLE_TUYALINKSDK_SAMPLES
        bool "Enable Build Tuya IoT Core SDK Sample Programs"
        default n
        depends on RTSMART_3RD_PARTY_ENABLE_TUYALINKSDK

    config RTSMART_3RD_PARTY_ENABLE_CJSON_SAMPLES
        bool "Enable Build cJSON Sample Programs"
        default n
        depends on RTSMART_3RD_PARTY_ENABLE_CJSON

    config RTSMART_3RD_PARTY_ENABLE_LIBWEBSOCKETS_SAMPLES
        bool "Enable Build libwebsockets Sample Programs"
        default n
        depends on RTSMART_3RD_PARTY_ENABLE_LIBWEBSOCKETS

    config RTSMART_3RD_PARTY_ENABLE_NIMBLE_SAMPLES
        bool "Enable Build NimBLE Sample Programs"
        default n
        depends on RTSMART_3RD_PARTY_ENABLE_NIMBLE

    config RTSMART_3RD_PARTY_ENABLE_IPERF3
        bool "Enable Build iperf3"
        default n
        help
            Build the upstream iperf3 command-line program for RT-Smart.
            The iperf source repository must be checked out in the iperf/iperf
            directory by the SDK repo manifest.

    menuconfig RTSMART_3RD_PARTY_ENABLE_XIAOZHI_SAMPLES
        bool "Enable Build xiaozhi Sample Programs"
        default n
        depends on RTSMART_3RD_PARTY_ENABLE_LIBWEBSOCKETS
        depends on RTSMART_3RD_PARTY_ENABLE_CJSON
        help
            Build the RT-Smart xiaozhi WebSocket client with MCP and K230
            Opus audio support.

        if RTSMART_3RD_PARTY_ENABLE_XIAOZHI_SAMPLES
            source "$(SDK_RTSMART_SRC_DIR)/examples/3rd-party/xiaozhi/Kconfig"
        endif

endif
```

## integrated_poc/Kconfig
```kconfig
if RTSMART_ENABLE_BUILD_INTEGRATED_EXAMPLES
    config RTSMART_INTEGRATED_EXAMPLES_SMART_IPC
        bool "Smart IPC examples"
        default y
        select RTSMART_3RD_PARTY_ENABLE_LIBPEER
    config RTSMART_INTEGRATED_EXAMPLES_MULTISOURCE_AI_ANALYZER
        bool "Multisource AI Analyzer"
        default n
        select MPP_ENABLE_MIDDLEWARE_LIB_FFMPEG
endif
```

## peripheral/Kconfig
```kconfig
if RTSMART_ENABLE_PERIPHERAL_EXAMPLES

    config RTSMART_PERIPHERAL_ENABLE_OTP_PROVISION
        bool "Enable Build otp_provision"
        default n
        help
            Program the base OTP region from either a raw web-tool payload or
            a single-part otp_data.kdimg generated by tools/gen_otp_config.py.

    config RTSMART_PERIPHERAL_ENABLE_FS_SPEEDTEST
        bool "Enable Build fs_speedtest"
        default y

    config RTSMART_PERIPHERAL_ENABLE_ADC
        bool "Enable Build adc"
        default y

    config RTSMART_PERIPHERAL_ENABLE_FFT
        bool "Enable Build fft"
        default y

    config RTSMART_PERIPHERAL_ENABLE_FPIOA
        bool "Enable Build fpioa"
        default y

    config RTSMART_PERIPHERAL_ENABLE_WLAN_OFFLOAD
        bool "Enable Build WLAN offload control example"
        default n
        help
            Build the userspace /dev/wlanctlN diagnostic using libwlan_offload. The
            RT-Smart kernel must enable the WLAN offload framework and userspace
            supplicant interface.

    config RTSMART_PERIPHERAL_ENABLE_GPIO
        bool "Enable Build gpio"
        default y

    config RTSMART_PERIPHERAL_ENABLE_GZIP_DECOMP
        bool "Enable Build gzip_decomp"
        default y

    config RTSMART_PERIPHERAL_ENABLE_I2C_SSD1306
        bool "Enable Build i2c_ssd1306"
        default y

    config RTSMART_PERIPHERAL_ENABLE_I2C_SLAVE
        bool "Enable Build i2c_slave"
        default y
        help
            Build the I2C controller master/slave loopback test. One I2C
            controller must be configured in slave mode in the RT-Smart
            kernel configuration.

    config RTSMART_PERIPHERAL_ENABLE_NETMGMT
        bool "Enable Build netmgmt"
        default y

    config RTSMART_PERIPHERAL_ENABLE_OTA
        bool "Enable Build ota"
        default y

    config RTSMART_PERIPHERAL_ENABLE_PMU
        bool "Enable Build pmu"
        default y

    config RTSMART_PERIPHERAL_ENABLE_PUFS
        bool "Enable Build pufs"
        default y

    config RTSMART_PERIPHERAL_ENABLE_PWM
        bool "Enable Build pwm"
        default y

    config RTSMART_PERIPHERAL_ENABLE_ROTARY_ENCODER
        bool "Enable Build rotary_encoder"
        default y

    config RTSMART_PERIPHERAL_ENABLE_SBUS
        bool "Enable Build sbus"
        default y

    config RTSMART_PERIPHERAL_ENABLE_SPI_ST7789
        bool "Enable Build spi_st7789"
        default y

    config RTSMART_PERIPHERAL_ENABLE_SPI_W25QXX
        bool "Enable Build spi_w25qxx"
        default y

    config RTSMART_PERIPHERAL_ENABLE_TIMER
        bool "Enable Build timer"
        default y

    config RTSMART_PERIPHERAL_ENABLE_TOUCH
        bool "Enable Build touch"
        default y

    config RTSMART_PERIPHERAL_ENABLE_TSENSOR
        bool "Enable Build tsensor"
        default y

    config RTSMART_PERIPHERAL_ENABLE_UART
        bool "Enable Build uart"
        default y

    config RTSMART_PERIPHERAL_ENABLE_USB_HID_KBD
        bool "Enable Build usb_hid_kbd"
        default y

    config RTSMART_PERIPHERAL_ENABLE_USB_HID_MOUSE
        bool "Enable Build usb_hid_mouse"
        default y

    config RTSMART_PERIPHERAL_ENABLE_VGLITE_TIGER
        bool "Enable Build vglite_tiger"
        default y
        select RTSMART_HAL_ENABLE_VG_LITE
        help
            Render and display the VG-Lite tiger sample.

    config RTSMART_PERIPHERAL_ENABLE_WDT
        bool "Enable Build wdt"
        default y

endif
```
